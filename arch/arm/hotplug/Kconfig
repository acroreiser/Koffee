## arch/arm/hotplug/Kconfig
```kconfig
config MSM_HOTPLUG
	bool
	depends on SMP && HOTPLUG

config INTELLI_PLUG
    bool "Enable intelli-plug cpu hotplug driver"
    depends on SMP && HOTPLUG
    help
      Generic Intelli-plug cpu hotplug driver for ARM SOCs
```

## drivers/video/mcde/Kconfig
```kconfig
config FB_MCDE
	tristate "MCDE support"
	depends on FB
	select FB_SYS_FILLRECT
	select FB_SYS_COPYAREA
	select FB_SYS_IMAGEBLIT
	select FB_SYS_FOPS
	select HWMEM
	---help---
	  This enables support for MCDE based frame buffer driver.

	  Please read the file <file:Documentation/fb/mcde.txt>

config FB_MCDE_DEBUG
	bool "MCDE debug messages"
	depends on FB_MCDE
	---help---
	  Say Y here if you want the MCDE driver to output debug messages

config FB_MCDE_VDEBUG
	bool "MCDE verbose debug messages"
	depends on FB_MCDE_DEBUG
	---help---
	  Say Y here if you want the MCDE driver to output more debug messages

config MCDE_FB_AVOID_REALLOC
	bool "MCDE early allocate framebuffer"
	default n
	depends on FB_MCDE
	---help---
	  If you say Y here maximum frame buffer size is allocated and
	  used for all resolutions. If you say N here, the frame buffer is
	  reallocated when resolution is changed. This reallocation might
	  fail because of fragmented memory. Note that this memory will
	  never be deallocated, while the MCDE framebuffer is used.

config MCDE_DISPLAY_DSI
	bool "Support for DSI displays within MCDE"
	depends on FB_MCDE
	default y

menu "MCDE DSI displays"
	depends on MCDE_DISPLAY_DSI

config MCDE_DISPLAY_GENERIC_DSI
	tristate "Generic DSI display driver"

config MCDE_DISPLAY_SAMSUNG_S6D16D0
	bool "Samsung S6D16D0 DSI display driver"
	---help---
	  Say Y if you have a TPO Taal or Blackpearl display panel.

config MCDE_DISPLAY_SONY_ACX424AKP_DSI
	tristate "Sony acx424akp DSI display driver"

config MCDE_DISPLAY_AV8100
	tristate "AV8100 HDMI/CVBS display driver"
	select AV8100

config MCDE_DISPLAY_HDMI_FB_AUTO_CREATE
	bool "HDMI_FB_AUTO_CREATE"
	default y
	depends on MCDE_DISPLAY_AV8100
	---help---
	  Say Y if you want the HDMI frame buffer to be created on start
	  Say N if you want the HDMI frame buffer to be created when HDMI
	  cable is plugged (needs user space HDMIservice)

endmenu

config MCDE_DISPLAY_DPI
	bool "Support for DPI displays within MCDE"
	depends on FB_MCDE
	default n
	---help---
	  Add this option to choose which DPI display driver for MCDE to include

	  DPI (Display Pixel Interface) is a MIPI Alliance standard used for
	  active-matrix LCDs. The DPI uses parallel data lines.

menu "MCDE DPI displays"
	depends on MCDE_DISPLAY_DPI

config MCDE_DISPLAY_VUIB500_DPI
	tristate "DPI display driver for the VUIB500 board"
	---help---
	  The VUIB500 is an ST-Ericsson user interface board.

config MCDE_DISPLAY_NASTEC_DPI
	tristate "DPI display driver for the NASTEC display"
	---help---
	  The NASTEC display is the display used the calao AVI board.

endmenu

config MCDE_DISPLAY_AB8500_DENC
	tristate "AB8500 CVBS display driver"
	depends on FB_MCDE
	select AB8500_DENC
```

## kernel/Kconfig.godmode
```kconfig
config GOD_MODE
	bool "god mode"
	default y
	help
	  Enables an unprivileged user to access/modify/execute 
	  files, which usually only root is allowed to.
```
